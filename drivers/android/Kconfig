## drivers/android/Kconfig
```kconfig
# SPDX-License-Identifier: GPL-2.0
menu "Android"

config ANDROID
	bool "Android Drivers"
	---help---
	  Enable support for various drivers needed on the Android platform

if ANDROID

config ANDROID_BINDER_IPC
	bool "Android Binder IPC Driver"
	depends on MMU
	default n
	---help---
	  Binder is used in Android for both communication between processes,
	  and remote method invocation.

	  This means one Android process can call a method/routine in another
	  Android process, using Binder to identify, invoke and pass arguments
	  between said processes.

config ANDROID_BINDERFS
	bool "Android Binderfs filesystem"
	depends on ANDROID_BINDER_IPC
	default n
	---help---
	  Binderfs is a pseudo-filesystem for the Android Binder IPC driver
	  which can be mounted per-ipc namespace allowing to run multiple
	  instances of Android.
	  Each binderfs mount initially only contains a binder-control device.
	  It can be used to dynamically allocate new binder IPC devices via
	  ioctls.

config ANDROID_BINDER_DEVICES
	string "Android Binder devices"
	depends on ANDROID_BINDER_IPC
	default "binder,hwbinder,vndbinder"
	---help---
	  Default value for the binder.devices parameter.

	  The binder.devices parameter is a comma-separated list of strings
	  that specifies the names of the binder device nodes that will be
	  created. Each binder device has its own context manager, and is
	  therefore logically separated from the other devices.

config ANDROID_BINDER_IPC_SELFTEST
	bool "Android Binder IPC Driver Selftest"
	depends on ANDROID_BINDER_IPC
	---help---
	  This feature allows binder selftest to run.

	  Binder selftest checks the allocation and free of binder buffers
	  exhaustively with combinations of various buffer sizes and
	  alignments.

config ANDROID_VENDOR_HOOKS
	bool "Android Vendor Hooks"
	depends on TRACEPOINTS
	---help---
	  Enable vendor hooks implemented as tracepoints
	  Allow vendor modules to attach to tracepoint "hooks" defined via
	  DECLARE_HOOK or DECLARE_RESTRICTED_HOOK.

config ANDROID_SIMPLE_LMK
	bool "Simple Android Low Memory Killer"
	depends on !ANDROID_LOW_MEMORY_KILLER
	select PSI
	---help---
	  This is a complete low memory killer solution for Android that is
	  small and simple. Processes are killed according to the priorities
	  that Android gives them, so that the least important processes are
	  always killed first. Processes are killed until memory deficits are
	  satisfied, as observed from memory pressure stalls via PSI.

if ANDROID_SIMPLE_LMK

config ANDROID_SIMPLE_LMK_PSI_THRESHOLD_US
	int "PSI memory stall threshold in microseconds"
	range 1000 10000000
	default 150000
	help
	  Simple LMK reclaims once per PSI window in which at least this many
	  microseconds were spent stalled on memory. This is an ABSOLUTE
	  duration, not a percentage: 150000 over the default 2s window means
	  7.5%. Both values are writable at runtime under
	  /sys/module/simple_lmk/parameters/ to tune the trigger.

config ANDROID_SIMPLE_LMK_PSI_WINDOW_US
	int "PSI memory stall window in microseconds"
	range 500000 10000000
	default 2000000
	help
	  The window over which the stall threshold above is measured. PSI
	  rate-limits the trigger to one event per window, so this also caps
	  how often Simple LMK can reclaim.

config ANDROID_SIMPLE_LMK_MAX_KILLS
	int "Maximum processes killed per reclaim"
	range 1 256
	default 6
	help
	  Upper bound on how many processes a single reclaim may kill,
	  independent of how much memory that frees. This is the hard stop on
	  over-kill: a reclaim that cannot reach its target kills at most this
	  many processes and lets the next PSI window finish the job.
	  The victim array holds 256 entries, so a larger cap cannot take
	  effect.

config ANDROID_SIMPLE_LMK_TIMEOUT_MSEC
	int "Reaper retry timeout in milliseconds"
	range 50 1000
	default 200
	help
	  Simple LMK's reaper tries to reap a victim's memory while its
	  mmap_sem is contended.  If the memory still can't be reaped after
	  this timeout, the reaper gives up and lets exit_mmap() handle it.
	  This is also the maximum time the reaper waits for a victim that
	  never yields mmap_sem, so it bounds how long reaping can take.

config ANDROID_SIMPLE_LMK_DECAY_MSEC
	int "Time-decay window for anonymous pages in milliseconds"
	range 100 10000
	default 1000
	help
	  Anonymous pages of a victim that were accessed within this window
	  are decayed proportionally, so that processes holding cold (stale)
	  anonymous memory are prioritized as victims over processes that are
	  actively touching their memory.

endif

config ANDROID_KABI_RESERVE
	bool "Android KABI reserve padding"
	default y
	help
	  This option enables the padding that the Android GKI kernel adds
	  to many different kernel structures to support an in-kernel stable ABI
	  over the lifespan of support for the kernel.

	  Only disable this option if you have a system that needs the Android
	  kernel drivers, but is NOT an Android GKI kernel image. If disabled
	  it has the possibility to make the kernel static and runtime image
	  slightly smaller but will NOT be supported by the Google Android
	  kernel team.

	  If even slightly unsure, say Y.

endif # if ANDROID
endmenu
```
